## ots-fw-keypad/sdkconfig.defaults
```kconfig
# ESP32-S3 Configuration
CONFIG_IDF_TARGET="esp32s3"

# FreeRTOS
CONFIG_FREERTOS_HZ=1000

# Serial Console
CONFIG_ESP_CONSOLE_UART_DEFAULT=y
CONFIG_ESP_CONSOLE_UART_NUM=0
CONFIG_ESP_CONSOLE_UART_BAUDRATE=115200

# Logging
CONFIG_LOG_DEFAULT_LEVEL_INFO=y
CONFIG_LOG_MAXIMUM_LEVEL_VERBOSE=y

# NVS
CONFIG_NVS_ENCRYPTION=n

# Compiler optimizations
CONFIG_COMPILER_OPTIMIZATION_SIZE=y
```
